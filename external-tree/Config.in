## external-tree/board/zynq/image.its
```
/dts-v1/;
/ {
	description = "Example of 7K image";
	#address-cells = <1>;
	images {
		kernel-1 {
			description = "Linux Kernel";
			data = /incbin/("./zImage");
			type = "kernel";
			arch = "arm";
			os = "linux";
			compression = "none";
			load = <0x00080000>;
			entry = <0x00080000>;
			hash-1 {
				algo = "sha1";
			};
		};
		fdt-1 {
			description = "Flattened Device Tree blob";
			data = /incbin/("./system-top.dtb");
			type = "flat_dt";
			arch = "arm";
			os = "linux";
			compression = "none";
			hash-1 {
				algo = "sha1";
			};
		};
		ramdisk-1 {
			description = "RAMDisk Image";
			data = /incbin/("./rootfs.cpio.lzma");
			type = "ramdisk";
			arch = "arm";
			os = "linux";
			compression = "lzma";
			load = <0x08000000>;
			entry = <0x08000000>;
			hash-1 {
				algo = "sha1";
			};
		};
	};
	configurations {
		default = "conf-1";
		conf-1 {
			description = "Boot Linux kernel with FDT blob + ramdisk";
			kernel = "kernel-1";
			fdt = "fdt-1";
			ramdisk = "ramdisk-1";
			hash-1 {
				algo = "sha1";
			};
		};
	};
};
```

## external-tree/board/zynqmp/image.its
```
/dts-v1/;
/ {
	description = "XXX Name image";
	#address-cells = <1>;
	images {
		kernel-1 {
			description = "Linux Kernel";
			data = /incbin/("./Image.gz");
			type = "kernel";
			arch = "arm64";
			os = "linux";
			compression = "gzip";
			load = <0x00080000>;
			entry = <0x00080000>;
			hash-1 {
				algo = "sha1";
			};
		};
		fdt-1 {
			description = "Flattened Device Tree blob";
			data = /incbin/("./kernel.dtb");
			type = "flat_dt";
			arch = "arm64";
			os = "linux";
			compression = "none";
			hash-1 {
				algo = "sha1";
			};
		};
		ramdisk-1 {
			description = "RAMDisk Image";
			data = /incbin/("./rootfs.cpio.lzma");
			type = "ramdisk";
			arch = "arm64";
			os = "linux";
			compression = "lzma";
			load = <0x10000000>;
			entry = <0x10000000>;
			hash-1 {
				algo = "sha1";
			};
		};
	};
	configurations {
		default = "conf-1";
		conf-1 {
			description = "Boot Linux kernel with FDT blob + ramdisk";
			kernel = "kernel-1";
			fdt = "fdt-1";
			ramdisk = "ramdisk-1";
			hash-1 {
				algo = "sha1";
			};
		};
	};
};
```

## external-tree/configs/zynq_defconfig
```kconfig
# Toolchain

BR2_arm=y
BR2_cortex_a9=y
BR2_GCC_ENABLE_LTO=y
BR2_ARM_ENABLE_NEON=y
BR2_ARM_ENABLE_VFP=y
BR2_GCC_ENABLE_OPENMP=y
BR2_KERNEL_HEADERS_5_15=y
BR2_TOOLCHAIN_BUILDROOT_CXX=y
BR2_TOOLCHAIN_BUILDROOT_GLIBC=y

# Linux Kernel

BR2_LINUX_KERNEL=y
BR2_LINUX_KERNEL_CUSTOM_GIT=y
BR2_LINUX_KERNEL_CUSTOM_REPO_URL="https://github.com/Xilinx/linux-xlnx.git"
BR2_LINUX_KERNEL_CUSTOM_REPO_VERSION="xlnx_rebase_v5.15_LTS_2022.2"
# BR2_LINUX_KERNEL_DEFCONFIG="xilinx_zynq"
BR2_LINUX_KERNEL_USE_CUSTOM_CONFIG=y
BR2_LINUX_KERNEL_CUSTOM_CONFIG_FILE="$(BR2_EXTERNAL_EDU_PATH)/board/zynq/kernel.config"
BR2_LINUX_KERNEL_DTS_SUPPORT=y
BR2_LINUX_KERNEL_USE_CUSTOM_DTS=y
BR2_LINUX_KERNEL_CUSTOM_DTS_PATH="$(BR2_EXTERNAL_EDU_PATH)/board/zynq/dts/*.dtsi $(BR2_EXTERNAL_EDU_PATH)/board/zynq/dts/system-top.dts"


# Packages, public


BR2_PACKAGE_BUSYBOX_SHOW_OTHERS=y
BR2_PACKAGE_COREUTILS=y
BR2_PACKAGE_DROPBEAR=y
BR2_PACKAGE_DROPBEAR_DISABLE_REVERSEDNS=y
BR2_PACKAGE_DROPBEAR_LASTLOG=y
BR2_PACKAGE_DROPBEAR_WTMP=y
BR2_PACKAGE_ETHTOOL=y
BR2_PACKAGE_GSL=y
BR2_PACKAGE_HAVEGED=y
# BR2_PACKAGE_OPENSSL=y
BR2_PACKAGE_SPI_TOOLS=y
BR2_PACKAGE_I2C_TOOLS=y
BR2_PACKAGE_TCF_AGENT=y
BR2_PACKAGE_LIBGPIOD=y
BR2_PACKAGE_NANO=y

BR2_PACKAGE_PYTHON3=y
BR2_PACKAGE_PYTHON_NUMPY=y
BR2_PACKAGE_PYTHON_IPYTHON=y

# Custom 

BR2_PACKAGE_PYTHON_GPIOD=y
BR2_PACKAGE_PYTHON_SMBUS2=y


# Target

BR2_TARGET_GENERIC_GETTY_BAUDRATE_115200=y
BR2_TARGET_GENERIC_GETTY_PORT="ttyPS0"
BR2_TARGET_GENERIC_HOSTNAME="ZynqEDU"
BR2_TARGET_GENERIC_ISSUE="Welcome to Zynq Arty Linux"
BR2_TARGET_GENERIC_PASSWD_SHA512=y
BR2_TARGET_GENERIC_ROOT_PASSWD="root"
BR2_TARGET_ROOTFS_CPIO=y
BR2_TARGET_ROOTFS_CPIO_LZMA=y
# BR2_TARGET_ROOTFS_CPIO_XZ=y
# BR2_TARGET_ROOTFS_CPIO_GZIP=y
# BR2_TARGET_ROOTFS_CPIO_LZ4=y
# BR2_TARGET_ROOTFS_CPIO_BZIP2=y
# BR2_TARGET_ROOTFS_CPIO_LZO=y


# RootFS

BR2_ROOTFS_OVERLAY="$(BR2_EXTERNAL_EDU_PATH)/board/zynq/rootfs-overlay"
BR2_ROOTFS_POST_IMAGE_SCRIPT="$(BR2_EXTERNAL_EDU_PATH)/board/zynq/post-image.sh"
```

## external-tree/configs/zynqmp_defconfig
```kconfig
# Toolchain

BR2_aarch64=y
BR2_GCC_ENABLE_LTO=y
BR2_GCC_ENABLE_OPENMP=y
BR2_KERNEL_HEADERS_5_15=y
BR2_TOOLCHAIN_BUILDROOT_CXX=y
BR2_TOOLCHAIN_BUILDROOT_GLIBC=y

# Linux Kernel

BR2_LINUX_KERNEL=y
BR2_LINUX_KERNEL_CUSTOM_GIT=y
BR2_LINUX_KERNEL_CUSTOM_REPO_URL="https://github.com/Xilinx/linux-xlnx.git"
BR2_LINUX_KERNEL_CUSTOM_REPO_VERSION="xlnx_rebase_v5.15_LTS_2022.2"
BR2_LINUX_KERNEL_USE_CUSTOM_CONFIG=y
BR2_LINUX_KERNEL_CUSTOM_CONFIG_FILE="$(BR2_EXTERNAL_EDU_PATH)/board/zynqmp/kernel.config"
BR2_LINUX_KERNEL_DTS_SUPPORT=y
BR2_LINUX_KERNEL_USE_CUSTOM_DTS=y
BR2_LINUX_KERNEL_CUSTOM_DTS_PATH="$(BR2_EXTERNAL_EDU_PATH)/board/zynqmp/dts/*.dtsi $(BR2_EXTERNAL_EDU_PATH)/board/zynqmp/dts/system-top.dts"
BR2_LINUX_KERNEL_GZIP=y

# Packages, public

BR2_PACKAGE_BUSYBOX_SHOW_OTHERS=y
BR2_PACKAGE_COREUTILS=y
BR2_PACKAGE_DROPBEAR=y
BR2_PACKAGE_DROPBEAR_DISABLE_REVERSEDNS=y
BR2_PACKAGE_DROPBEAR_LASTLOG=y
BR2_PACKAGE_DROPBEAR_WTMP=y
BR2_PACKAGE_ETHTOOL=y
BR2_PACKAGE_GSL=y
BR2_PACKAGE_HAVEGED=y
BR2_PACKAGE_LIBGPIOD=y
BR2_PACKAGE_LIBGPIOD_TOOLS=y
BR2_PACKAGE_OPENSSL=y
BR2_PACKAGE_SPI_TOOLS=y
BR2_PACKAGE_I2C_TOOLS=y
BR2_PACKAGE_TCF_AGENT=y

BR2_PACKAGE_PYTHON3=y
BR2_PACKAGE_PYTHON_NUMPY=y
BR2_PACKAGE_PYTHON_IPYTHON=y

BR2_PACKAGE_KMOD=y
BR2_PACKAGE_KMOD_TOOLS=y

# Custom

BR2_PACKAGE_PYTHON_GPIOD=y

# Target

BR2_TARGET_GENERIC_GETTY_BAUDRATE_115200=y
BR2_TARGET_GENERIC_GETTY_PORT="ttyPS0"
BR2_TARGET_GENERIC_HOSTNAME="ZynqmpEDU"
BR2_TARGET_GENERIC_ISSUE="Welcome to te0820 Linux"
BR2_TARGET_GENERIC_PASSWD_SHA512=y
BR2_TARGET_GENERIC_ROOT_PASSWD="root"
BR2_TARGET_ROOTFS_CPIO=y
# BR2_TARGET_ROOTFS_CPIO_LZMA=y
# BR2_TARGET_ROOTFS_CPIO_XZ=y
# BR2_TARGET_ROOTFS_CPIO_GZIP=y
# BR2_TARGET_ROOTFS_CPIO_LZ4=y
# BR2_TARGET_ROOTFS_CPIO_BZIP2=y
BR2_TARGET_ROOTFS_CPIO_LZO=y


# RootFS

BR2_ROOTFS_OVERLAY="$(BR2_EXTERNAL_EDU_PATH)/board/zynqmp/rootfs-overlay"
BR2_ROOTFS_POST_IMAGE_SCRIPT="$(BR2_EXTERNAL_EDU_PATH)/board/zynqmp/post-image.sh"
```

## external-tree/package/fpgautil/Config.in
```kconfig
config BR2_PACKAGE_FPGAUTIL
	bool "fpgautil"
	help
	  Utility for programming PL from PS
```
